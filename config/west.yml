## config/west.yml
```yaml
manifest:
  remotes:
    - name: zmkfirmware
      url-base: https://github.com/zmkfirmware
    - name: johnm
      url-base: https://github.com/johnm
  projects:
    - name: zmk
      remote: johnm
      revision: main
      import: app/west.yml
  self:
    path: config
```
